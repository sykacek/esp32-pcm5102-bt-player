## sdkconfig.defaults
```kconfig
CONFIG_EXAMPLE_A2DP_SINK_SSP_ENABLED=y
CONFIG_EXAMPLE_A2DP_SINK_OUTPUT_EXTERNAL_I2S=y
CONFIG_EXAMPLE_I2S_LRCK_PIN=27
CONFIG_EXAMPLE_I2S_BCK_PIN=26
CONFIG_EXAMPLE_I2S_DATA_PIN=25
CONFIG_EXAMPLE_LOCAL_DEVICE_NAME="ESP_SPEAKER"
CONFIG_EXAMPLE_AVRCP_CT_COVER_ART_ENABLE=y

CONFIG_GPIO_RANGE_MAX=33
CONFIG_I2C_INTERFACE=y
CONFIG_SSD1306_128x64=y
CONFIG_OFFSETX=0
CONFIG_SCL_GPIO=22
CONFIG_SDA_GPIO=21
CONFIG_RESET_GPIO=15
CONFIG_I2C_PORT_0=y
```
